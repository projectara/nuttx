## apps/ara/Kconfig
```kconfig
#
# For a description of the syntax of this configuration file,
# see misc/tools/kconfig-language.txt.
#

source "$APPSDIR/ara/unipro/Kconfig"
source "$APPSDIR/ara/apbridge/Kconfig"
source "$APPSDIR/ara/apbridge-unipro/Kconfig"
source "$APPSDIR/ara/tca/Kconfig"
source "$APPSDIR/ara/lg/Kconfig"
source "$APPSDIR/ara/gpbridge/Kconfig"
```

## apps/ara/pm/Kconfig
```kconfig
#
# For a description of the syntax of this configuration file,
# see misc/tools/kconfig-language.txt.
#

config ARA_PM
	bool "GPB/APB power-management helper"
	depends on PM
	depends on ARCH_CHIP_TSB
	default n
	---help---
		Monitor system's power management activity, change power
		states, enable & disable power management.
```

## apps/system/Kconfig
```kconfig
#
# For a description of the syntax of this configuration file,
# see misc/tools/kconfig-language.txt.
#

menu "I2C tool"
source "$APPSDIR/system/i2c/Kconfig"
endmenu

menu "readline()"
source "$APPSDIR/system/readline/Kconfig"
endmenu
```

## nuttx/configs/Kconfig
```kconfig
#
# Copyright (c) 2014-2015 Google, Inc.
# All rights reserved.
#
# Redistribution and use in source and binary forms, with or without
# modification, are permitted provided that the following conditions are met:
# 1. Redistributions of source code must retain the above copyright notice,
# this list of conditions and the following disclaimer.
# 2. Redistributions in binary form must reproduce the above copyright notice,
# this list of conditions and the following disclaimer in the documentation
# and/or other materials provided with the distribution.
# 3. Neither the name of the copyright holder nor the names of its
# contributors may be used to endorse or promote products derived from this
# software without specific prior written permission.
#
# THIS SOFTWARE IS PROVIDED BY THE COPYRIGHT HOLDERS AND CONTRIBUTORS "AS IS"
# AND ANY EXPRESS OR IMPLIED WARRANTIES, INCLUDING, BUT NOT LIMITED TO,
# THE IMPLIED WARRANTIES OF MERCHANTABILITY AND FITNESS FOR A PARTICULAR
# PURPOSE ARE DISCLAIMED. IN NO EVENT SHALL THE COPYRIGHT HOLDER OR
# CONTRIBUTORS BE LIABLE FOR ANY DIRECT, INDIRECT, INCIDENTAL, SPECIAL,
# EXEMPLARY, OR CONSEQUENTIAL DAMAGES (INCLUDING, BUT NOT LIMITED TO,
# PROCUREMENT OF SUBSTITUTE GOODS OR SERVICES; LOSS OF USE, DATA, OR PROFITS;
# OR BUSINESS INTERRUPTION) HOWEVER CAUSED AND ON ANY THEORY OF LIABILITY,
# WHETHER IN CONTRACT, STRICT LIABILITY, OR TORT (INCLUDING NEGLIGENCE OR
# OTHERWISE) ARISING IN ANY WAY OUT OF THE USE OF THIS SOFTWARE, EVEN IF
# ADVISED OF THE POSSIBILITY OF SUCH DAMAGE.
#
# For a description of the syntax of this configuration file,
# see misc/tools/kconfig-language.txt.
#

choice
	prompt "Select target board"
	default ARCH_BOARD_CUSTOM
	---help---
		Select the board hosting the architure.  You must first select the
		exact MCU part number, then the boards supporting that part will
		be available for selection.  Use ARCH_BOARD_CUSTOM to create a new
		board configuration.

config ARCH_BOARD_ARA_BDB2A_SVC
	bool "ARA SVC in BDB2A"
	depends on ARCH_CHIP_STM32F407IG
	select ARCH_BOARD_ARA_SVC
	select SPI
	select SPI_OWNBUS
	select SPI_EXCHANGE
	select STM32_SPI1
	select SENSORS
	select INA230
	---help---
		The ARA SVC is based on the STMicro STM32F417IG microcontroller
		(ARM Cortex-M4 with FPU + crypto).
		This options selects the support for the SVC on the BDB2A
		development platform.
		This port uses a GNU Cortex-M4 toolchain (such as CodeSourcery).

config ARCH_BOARD_ARA_SDB_SVC
	bool "ARA SVC in SDB"
	depends on ARCH_CHIP_STM32F407IG
	select ARCH_BOARD_ARA_SVC
	select SPI
	select SPI_OWNBUS
	select SPI_EXCHANGE
	select STM32_SPI1
	select SENSORS
	select INA230
	---help---
		The ARA SVC is based on the STMicro STM32F417IG microcontroller
		(ARM Cortex-M4 with FPU + crypto).
		This options selects the support for the SVC on the SDB
		development platform, aka 'Software Dev Board'.
		This port uses a GNU Cortex-M4 toolchain (such as GCC ARM Embedded).

config ARCH_BOARD_ARA_DB3_SVC
	bool "ARA SVC on DB3"
	depends on ARCH_CHIP_STM32F446M
	select ARCH_BOARD_ARA_SVC
	select SPI
	select SPI_OWNBUS
	select SPI_EXCHANGE
	select STM32_SPI2
	---help---
		The ARA SVC is based on the STMicro STM32F4446MEY microcontroller
		(ARM Cortex-M4 with FPU + crypto).
		This options selects the support for the SVC on the DB3
		development platform.
		This port uses a GNU Cortex-M4 toolchain (such as GCC ARM Embedded).

config ARCH_BOARD_ARA_EVT1_SVC
	bool "ARA SVC on EVT1"
	depends on ARCH_CHIP_STM32F446M
	select ARCH_BOARD_ARA_SVC
	select SPI
	select SPI_OWNBUS
	select SPI_EXCHANGE
	select STM32_SPI2
	---help---
		The ARA SVC is based on the STMicro STM32F4446MEY microcontroller
		(ARM Cortex-M4 with FPU + crypto).
		This options selects the support for the SVC on the EVT1
		development platform.
		This port uses a GNU Cortex-M4 toolchain (such as GCC ARM Embedded).

config ARCH_BOARD_ARA_BRIDGE
	bool "Toshiba Bridge configuration"
	depends on ARCH_CHIP_TSB
	---help---
		Toshiba bridge

config ARCH_BOARD_CUSTOM
	bool "Custom development board"
	---help---
		Select this option if there is no directory for the board under configs/.

		Don't see the board you want?  You must first select the exact MCU part
		number, then the boards supporting that part will be available for selection.

endchoice

config ARCH_BOARD_ARA_SVC
	bool "Ara SVC support"
	select GPIO_DEBOUNCE
	select ARA_SVC_MAIN

config ARCH_BOARD_CUSTOM_DIR
	string "Custom board directory"
	depends on ARCH_BOARD_CUSTOM
	---help---
		If the custom board configuration is selected, then it is necessary
		to also tell the build system where it can find the board directory
		for the custom board. This may be either a relative path from the
		toplevel NuttX directory (like "configs/myboard") or an absolute path
		to some location outside of the NuttX source tree (like
		"~/projects/myboard").

config ARCH_BOARD
	string
	default "bdb"                 if ARCH_BOARD_BDB
	default "ara/bridge"          if ARCH_BOARD_ARA_BRIDGE
	default "ara/svc"             if ARCH_BOARD_ARA_SVC

comment "Common Board Options"

config ARCH_HAVE_LEDS
	bool

config ARCH_LEDS
	bool "Board LED support"
	default y
	depends on ARCH_HAVE_LEDS
	---help---
		Use board LEDs to show NuttX execution status state. Unique to boards that have LEDs

config ARCH_HAVE_BUTTONS
	bool

config ARCH_BUTTONS
	bool "Board button support"
	default n
	depends on ARCH_HAVE_BUTTONS
	---help---
		"Support interfaces to use buttons provided by the board."

config ARCH_HAVE_IRQBUTTONS
	bool

config ARCH_IRQBUTTONS
	bool "Button interrupt support"
	default n
	depends on ARCH_BUTTONS && ARCH_HAVE_IRQBUTTONS
	---help---
		"Support interrupts on button presses and releases."

config NSH_MMCSDMINOR
	int "MMC/SD minor number"
	default 0
	depends on NSH_LIBRARY && MMCSD
	---help---
		If board-specific NSH start-up logic needs to mount an MMC/SD device, then the setting should be provided to identify the MMC/SD minor device number (i.e., the N in /dev/mmcsdN).  Default 0

config NSH_MMCSDSLOTNO
	int "MMC/SD slot number"
	default 0
	depends on NSH_LIBRARY && MMCSD
	---help---
		If board-specific NSH start-up supports more than one MMC/SD slot, then this setting should be provided to indicate which slot should be used.  Default: 0.

config NSH_MMCSDSPIPORTNO
	int "MMC/SD SPI device number"
	default 0
	depends on NSH_LIBRARY && MMCSD && MMCSD_SPI
	---help---
		If board-specif NSH start-up logic will mount an SPI-based MMC/SD volume, then this setting may be needed to tell the board logic which SPI bus to use.  Default: 0 (meaning is board-specific).

comment "Board-Specific Options"

if ARCH_BOARD_ARA_BRIDGE
source "configs/ara/bridge/Kconfig"
endif

if ARCH_BOARD_ARA_SVC
source "configs/ara/svc/Kconfig"
endif
```

## nuttx/configs/ara/bridge/Kconfig
```kconfig
#
# Copyright (c) 2015-2016 Google Inc.
# All rights reserved.
#
# Redistribution and use in source and binary forms, with or without
# modification, are permitted provided that the following conditions are met:
# 1. Redistributions of source code must retain the above copyright notice,
# this list of conditions and the following disclaimer.
# 2. Redistributions in binary form must reproduce the above copyright notice,
# this list of conditions and the following disclaimer in the documentation
# and/or other materials provided with the distribution.
# 3. Neither the name of the copyright holder nor the names of its
# contributors may be used to endorse or promote products derived from this
# software without specific prior written permission.
#
# THIS SOFTWARE IS PROVIDED BY THE COPYRIGHT HOLDERS AND CONTRIBUTORS "AS IS"
# AND ANY EXPRESS OR IMPLIED WARRANTIES, INCLUDING, BUT NOT LIMITED TO,
# THE IMPLIED WARRANTIES OF MERCHANTABILITY AND FITNESS FOR A PARTICULAR
# PURPOSE ARE DISCLAIMED. IN NO EVENT SHALL THE COPYRIGHT HOLDER OR
# CONTRIBUTORS BE LIABLE FOR ANY DIRECT, INDIRECT, INCIDENTAL, SPECIAL,
# EXEMPLARY, OR CONSEQUENTIAL DAMAGES (INCLUDING, BUT NOT LIMITED TO,
# PROCUREMENT OF SUBSTITUTE GOODS OR SERVICES; LOSS OF USE, DATA, OR PROFITS;
# OR BUSINESS INTERRUPTION) HOWEVER CAUSED AND ON ANY THEORY OF LIABILITY,
# WHETHER IN CONTRACT, STRICT LIABILITY, OR TORT (INCLUDING NEGLIGENCE OR
# OTHERWISE) ARISING IN ANY WAY OUT OF THE USE OF THIS SOFTWARE, EVEN IF
# ADVISED OF THE POSSIBILITY OF SUCH DAMAGE.

if ARCH_BOARD_ARA_BRIDGE

config ARA_BRIDGE_HAVE_USB4624
	bool
	depends on ARCH_CHIP_USB_HCD
	depends on DEVICE_CORE
	default y

config ARA_BRIDGE_HAVE_USB3813
	bool
	depends on ARCH_CHIP_USB_PCD
	depends on DEVICE_CORE
	default y

config ARA_BRIDGE_HAVE_HID_DEVICE
	bool "Generic HID Device Driver"
	select DEVICE_CORE
	default n
	---help---
		This is a generic HID driver that vendor
		can hook up with HW  specific require code
		in FDK

config ARA_BRIDGE_HAVE_HID_TOUCH
	bool "Multi-Touch HID Support"
	depends on ARA_BRIDGE_HAVE_HID_DEVICE
	select GPIO
	select DEVICE_CORE
	default n
	---help---
		Multi-Touch HID Device Driver

config ARA_BRIDGE_HAVE_LIGHTS
	bool "Lights Support"
	select DEVICE_CORE
	default n
	---help---
		Lights Device Driver

config ARA_BRIDGE_HAVE_POWER_SUPPLY
	bool "Power Supply Support"
	select DEVICE_CORE
	default n
	---help---
		Power Supply Driver

config APBRIDGEA_AUDIO
	bool "Direct audio data streaming to/from APBridgeA"
	depends on APBRIDGEA
	select APBRIDGEA_INTERCEPT
	select DEVICE_CORE
	select LIB_RING_BUF
	default n
	---help---
		Normally, Greybus Audio Data Messages are sent between the
		AP and APBridgeA using the standard USB/HSIC link between
		the AP and APBridgeA.  However, APBridgeA has its own I2S
		port and can send and receive audio data through that port.
		This option enables that feature.  Enabling this feature
		does not prevent the USB/HSIC link from being used unless
		direct audio data streaming is enabled for that CPort.

		When enabled, I2S port and Greybus Audio Data message
		configuration is done by the AP using APBridgeA's Special
		Audio Protocol.  Messages for this protocol are sent and
		received between the AP and APBridgeA using USB control
		messages.

		When active, I2S data received on APBridgeA's I2S port will
		be packetized into Greybus Audio Data Messages and sent to
		an Audio Module using the specified CPort.  Greybus Audio
		Data Messages received from an Audio Module on the specified
		CPort will be de-packetized and sent out APBridgeA's I2S port.

choice
	prompt "Board"
	---help---
		Board which bridge firmware runs on. Examples include a
		software dev board (SDB or DB3), or form-factor module (EVT1).

config ARA_BRIDGE_BOARD_ARA_DEVBOARD
	bool "Bridge on ARA development board"

config ARA_BRIDGE_BOARD_OOT
	bool "Board whose sources are out-of-tree"
	---help---
		With this choice, the object files in OOT_OBJS will be linked with
		the in-tree object files.
endchoice

if APBRIDGEA
# USBDEV_DMA is required by APBridgeA gadget
# but the option is not available if USBDEV is not selected.
if !USBDEV
config USBDEV_DMA
	bool
endif

config APBRIDGE_VENDORID
	hex "Vendor ID"

config APBRIDGE_PRODUCTID
	hex "Product ID"

config APB_USB_LOG
	bool "Send APB log over usb"

config USB_LOG_BUFFER_SIZE
	int "Size of log buffer"
	default 4096
	depends on APB_USB_LOG
endif

endif
```

## nuttx/drivers/ara/audio/Kconfig
```kconfig
#
# Copyright (c) 2016 Google, Inc.
# All rights reserved.
#
# Redistribution and use in source and binary forms, with or without
# modification, are permitted provided that the following conditions are met:
# 1. Redistributions of source code must retain the above copyright notice,
# this list of conditions and the following disclaimer.
# 2. Redistributions in binary form must reproduce the above copyright notice,
# this list of conditions and the following disclaimer in the documentation
# and/or other materials provided with the distribution.
# 3. Neither the name of the copyright holder nor the names of its
# contributors may be used to endorse or promote products derived from this
# software without specific prior written permission.
#
# THIS SOFTWARE IS PROVIDED BY THE COPYRIGHT HOLDERS AND CONTRIBUTORS "AS IS"
# AND ANY EXPRESS OR IMPLIED WARRANTIES, INCLUDING, BUT NOT LIMITED TO,
# THE IMPLIED WARRANTIES OF MERCHANTABILITY AND FITNESS FOR A PARTICULAR
# PURPOSE ARE DISCLAIMED. IN NO EVENT SHALL THE COPYRIGHT HOLDER OR
# CONTRIBUTORS BE LIABLE FOR ANY DIRECT, INDIRECT, INCIDENTAL, SPECIAL,
# EXEMPLARY, OR CONSEQUENTIAL DAMAGES (INCLUDING, BUT NOT LIMITED TO,
# PROCUREMENT OF SUBSTITUTE GOODS OR SERVICES; LOSS OF USE, DATA, OR PROFITS;
# OR BUSINESS INTERRUPTION) HOWEVER CAUSED AND ON ANY THEORY OF LIABILITY,
# WHETHER IN CONTRACT, STRICT LIABILITY, OR TORT (INCLUDING NEGLIGENCE OR
# OTHERWISE) ARISING IN ANY WAY OUT OF THE USE OF THIS SOFTWARE, EVEN IF
# ADVISED OF THE POSSIBILITY OF SUCH DAMAGE.
#

config DRIVERS_ARA_AUDIO_BOARD
	bool "Audio board support"
	default n
	---help---
		A Greybus Audio Module has at least one Audio Bundle.
		Each Audio Bundle represents an audio codec and has
		exactly one Audio Management CPort and one or more
		Audio Data CPorts.  Each Audio Data CPort corresponds
		to a usable I2S connection on the associated codec.
		An I2S connection is also known as a Digital Audio
		Interface (DAI).

		Audio Bundle information is specified in the module's
		interface manifest but there is no easy way for drivers
		on the module to access that information.  This driver
		provides that information in a relatively easy manner
		and is required for Greybus audio to work.

config DRIVERS_ARA_AUDIO_CODEC
	bool

config DRIVERS_ARA_AUDIO_RT5647
	bool "Realtek ALC5647 Audio Codec Support"
	depends on DRIVERS_ARA_AUDIO_BOARD
	select DRIVERS_ARA_AUDIO_CODEC
	default n
	---help---
		Select to enable Greybus audio support using the
		Realtek ALC5647 audio codec.

config DRIVERS_ARA_AUDIO_NXP9890
	bool "NXP TFA9890A Audio Codec Support (Skeleton)"
	depends on DRIVERS_ARA_AUDIO_BOARD
	select DRIVERS_ARA_AUDIO_CODEC
	default n
	---help---
		Select to enable Greybus audio support using the
		NXP TFA9890A audio codec.
```
